## Kconfig
```kconfig
#  This file is part of LiTE-examples.
#
#  Permission is hereby granted, free of charge, to any person obtaining a copy
#  of this software and associated documentation files (the "Software"), to deal
#  in the Software without restriction, including without limitation the rights
#  to use, copy, modify, merge, publish, distribute, sublicense, and/or sell
#  copies of the Software, and to permit persons to whom the Software is
#  furnished to do so, subject to the following conditions:
#
#  The above copyright notice and this permission notice shall be included in
#  all copies or substantial portions of the Software.
#
#  THE SOFTWARE IS PROVIDED "AS IS", WITHOUT WARRANTY OF ANY KIND, EXPRESS OR
#  IMPLIED, INCLUDING BUT NOT LIMITED TO THE WARRANTIES OF MERCHANTABILITY,
#  FITNESS FOR A PARTICULAR PURPOSE AND NONINFRINGEMENT. IN NO EVENT SHALL THE
#  AUTHORS OR COPYRIGHT HOLDERS BE LIABLE FOR ANY CLAIM, DAMAGES OR OTHER
#  LIABILITY, WHETHER IN AN ACTION OF CONTRACT, TORT OR OTHERWISE, ARISING FROM,
#  OUT OF OR IN CONNECTION WITH THE SOFTWARE OR THE USE OR OTHER DEALINGS IN
#  THE SOFTWARE.

config EXAMPLES_LITE
	tristate "LiTE examples"
	default n
	depends on GRAPHICS_LITE
	---help---
		Enable LiTE examples.

if EXAMPLES_LITE

choice
	prompt "Example selection"
	default LITE_ANIMATION

config LITE_ANIMATION
	bool "lite_animation"

config LITE_BUTTON
	bool "lite_button"

config LITE_CHECK
	bool "lite_check"

config LITE_IMAGE
	bool "lite_image"

config LITE_LABEL
	bool "lite_label"

config LITE_LIST
	bool "lite_list"

config LITE_PROGRESSBAR
	bool "lite_progressbar"

config LITE_SCROLLBAR
	bool "lite_scrollbar"

config LITE_SLIDER
	bool "lite_slider"

config LITE_TEXTBUTTON
	bool "lite_textbutton"

config LITE_TEXTLINE
	bool "lite_textline"

endchoice

endif
```
